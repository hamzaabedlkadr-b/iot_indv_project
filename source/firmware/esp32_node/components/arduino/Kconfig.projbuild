## source/firmware/esp32_node/components/arduino/Kconfig.projbuild
```kconfig
menu "Arduino Configuration"

config ARDUINO_VARIANT
    string "Arduino target variant (board)"
    default IDF_TARGET

config ENABLE_ARDUINO_DEPENDS
    bool
    default y

config AUTOSTART_ARDUINO
    bool "Autostart Arduino setup and loop on boot"
    default n

choice ARDUINO_RUNNING_CORE_CHOICE
    bool "Core on which Arduino's setup and loop are running"
    default ARDUINO_RUN_CORE0 if FREERTOS_UNICORE
    default ARDUINO_RUN_CORE1 if !FREERTOS_UNICORE

    config ARDUINO_RUN_CORE0
        bool "CORE 0"
    config ARDUINO_RUN_CORE1
        bool "CORE 1"
        depends on !FREERTOS_UNICORE
    config ARDUINO_RUN_NO_AFFINITY
        bool "BOTH"
        depends on !FREERTOS_UNICORE
endchoice

config ARDUINO_RUNNING_CORE
    int
    default 0 if ARDUINO_RUN_CORE0
    default 1 if ARDUINO_RUN_CORE1
    default -1 if ARDUINO_RUN_NO_AFFINITY

config ARDUINO_LOOP_STACK_SIZE
    int "Loop thread stack size"
    default 8192

choice ARDUINO_EVENT_RUNNING_CORE_CHOICE
    bool "Core on which Arduino's event handler is running"
    default ARDUINO_EVENT_RUN_CORE0 if FREERTOS_UNICORE
    default ARDUINO_EVENT_RUN_CORE1 if !FREERTOS_UNICORE

    config ARDUINO_EVENT_RUN_CORE0
        bool "CORE 0"
    config ARDUINO_EVENT_RUN_CORE1
        bool "CORE 1"
        depends on !FREERTOS_UNICORE
    config ARDUINO_EVENT_RUN_NO_AFFINITY
        bool "BOTH"
        depends on !FREERTOS_UNICORE
endchoice

config ARDUINO_EVENT_RUNNING_CORE
    int
    default 0 if ARDUINO_EVENT_RUN_CORE0
    default 1 if ARDUINO_EVENT_RUN_CORE1
    default -1 if ARDUINO_EVENT_RUN_NO_AFFINITY

choice ARDUINO_SERIAL_EVENT_TASK_RUNNING_CORE_CHOICE
    bool "Core on which Arduino's Serial Event task runs"
    default ARDUINO_SERIAL_EVENT_RUN_CORE0 if FREERTOS_UNICORE
    default ARDUINO_SERIAL_EVENT_RUN_NO_AFFINITY if !FREERTOS_UNICORE

    config ARDUINO_SERIAL_EVENT_RUN_CORE0
        bool "CORE 0"
    config ARDUINO_SERIAL_EVENT_RUN_CORE1
        bool "CORE 1"
        depends on !FREERTOS_UNICORE
    config ARDUINO_SERIAL_EVENT_RUN_NO_AFFINITY
        bool "BOTH"
        depends on !FREERTOS_UNICORE
endchoice

config ARDUINO_SERIAL_EVENT_TASK_RUNNING_CORE
    int
    default 0 if ARDUINO_SERIAL_EVENT_RUN_CORE0
    default 1 if ARDUINO_SERIAL_EVENT_RUN_CORE1
    default -1 if ARDUINO_SERIAL_EVENT_RUN_NO_AFFINITY

config ARDUINO_SERIAL_EVENT_TASK_STACK_SIZE
    int "Serial Event task stack size"
    default 2048

config ARDUINO_SERIAL_EVENT_TASK_PRIORITY
    int "Serial Event task priority"
    default 24

config ARDUINO_ISR_IRAM
    bool "Run interrupts in IRAM"
    default n

config DISABLE_HAL_LOCKS
    bool "Disable mutex locks for HAL"
    default n

endmenu
```
